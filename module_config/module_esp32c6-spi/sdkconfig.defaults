## module_config/module_esp32c6-spi/sdkconfig.defaults
```kconfig
# ESP32-C6 SPI AT Configuration for Monstatek M1
# Clean minimal config — conflicting options removed
CONFIG_IDF_TARGET="esp32c6"
CONFIG_IDF_TARGET_ESP32C6=y

# ---- SPI Transport ----
CONFIG_AT_BASE_ON_SPI=y
CONFIG_AT_BASE_ON_UART=n

# ---- Flash ----
# Force 40MHz — ESP32-C6 Kconfig defaults to 80MHz which causes SHA errors
CONFIG_ESPTOOLPY_FLASHMODE_DIO=y
CONFIG_ESPTOOLPY_FLASHFREQ_40M=y
# CONFIG_ESPTOOLPY_FLASHFREQ_80M is not set
# CONFIG_ESPTOOLPY_FLASHFREQ_80M_DEFAULT is not set
CONFIG_ESPTOOLPY_FLASHSIZE_4MB=y

# ---- Partition Table ----
CONFIG_PARTITION_TABLE_CUSTOM=y
CONFIG_PARTITION_TABLE_CUSTOM_FILENAME="module_config/module_esp32c6-spi/partitions_at.csv"
CONFIG_PARTITION_TABLE_FILENAME="module_config/module_esp32c6-spi/partitions_at.csv"
CONFIG_PARTITION_TABLE_OFFSET=0x8000

# ---- SPI GPIO for Monstatek M1 ----
CONFIG_SPI_STANDARD_MODE=y
CONFIG_SPI_MODE=1
CONFIG_SPI_SCLK_PIN=7
CONFIG_SPI_MOSI_PIN=12
CONFIG_SPI_MISO_PIN=13
CONFIG_SPI_CS_PIN=15
CONFIG_SPI_HANDSHAKE_PIN=14
CONFIG_SPI_NUM=1
CONFIG_TX_STREAM_BUFFER_SIZE=8192
CONFIG_RX_STREAM_BUFFER_SIZE=8192

# ---- Bluetooth — satisfy linker for precompiled AT core ----
CONFIG_BT_ENABLED=y
CONFIG_BT_NIMBLE_ENABLED=y
CONFIG_BT_NIMBLE_ROLE_PERIPHERAL=y
CONFIG_BT_NIMBLE_BLUFI_ENABLE=y
CONFIG_BT_NIMBLE_50_FEATURE_SUPPORT=y
CONFIG_BT_NIMBLE_EXT_ADV=y
CONFIG_BT_NIMBLE_DYNAMIC_SERVICE=y

# ---- TLS — server needed by AT core lib ----
CONFIG_MBEDTLS_DHM_C=y
CONFIG_ESP_TLS_SERVER=y
CONFIG_ESP_TLS_PSK_VERIFICATION=y

# ---- AT Customized Partitions ----
CONFIG_AT_CUSTOMIZED_PARTITION_TABLE_FILE="module_config/module_esp32c6-spi/at_customize.csv"
CONFIG_AT_CUSTOMIZED_PARTITION_TABLE_OFFSET=0x1e000

# ---- AT Config ----
CONFIG_AT_ENABLE=y
CONFIG_AT_PROCESS_TASK_STACK_SIZE=6144
CONFIG_AT_SOCKET_MAX_CONN_NUM=5

# ---- Disable USB Serial/JTAG secondary console ----
CONFIG_ESP_CONSOLE_SECONDARY_NONE=y
# CONFIG_ESP_CONSOLE_SECONDARY_USB_SERIAL_JTAG is not set

# ---- Logging ----
CONFIG_LOG_DEFAULT_LEVEL_WARN=y
CONFIG_BOOTLOADER_LOG_LEVEL_WARN=y

# ---- Panic handler — IRAM so it runs even when flash is broken ----
CONFIG_ESP_PANIC_HANDLER_IRAM=y
CONFIG_ESP_SYSTEM_PANIC_PRINT_HALT=y

# ---- Core dump to UART ----
CONFIG_ESP_COREDUMP_ENABLE_TO_UART=y
CONFIG_ESP_COREDUMP_DATA_FORMAT_ELF=y
CONFIG_ESP_COREDUMP_CHECKSUM_CRC32=y

# ---- Bootloader watchdog — extended for debug output ----
CONFIG_BOOTLOADER_WDT_ENABLE=y
CONFIG_BOOTLOADER_WDT_TIME_MS=15000

# ---- FreeRTOS ----
CONFIG_FREERTOS_UNICORE=y
CONFIG_FREERTOS_HZ=1000

# ---- Wear Levelling ----
CONFIG_WL_SECTOR_SIZE_512=y

# ---- Watchdog ----
CONFIG_ESP_TASK_WDT_TIMEOUT_S=60
CONFIG_ESP_TASK_WDT_PANIC=y
```
